## Kconfig
```kconfig
# Kconfig file for package zbar
menuconfig PKG_USING_ZBAR
    bool "ZBAR: Qrcode reader for rt-thread"
    default n

if PKG_USING_ZBAR

    config PKG_ZBAR_PATH
        string
        default "/packages/multimedia/rt_zbar"

    config BSP_USING_SRC_INSTEAD_LIB
        bool "Using zbar src instead of lib"
        default n

    choice
        prompt "Version"
        default PKG_USING_ZBAR_LATEST_VERSION
        help
            Select the package version

        config PKG_USING_ZBAR_LATEST_VERSION
            bool "latest"
    endchoice
          
    config PKG_ZBAR_VER
       string
       default "latest"    if PKG_USING_ZBAR_LATEST_VERSION

endif
```
